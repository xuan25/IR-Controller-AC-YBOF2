#include "oled.h"
#include "oled_font.h"
#include "i2c.h"
#include <string.h>

#define RES_X 128
#define RES_Y 64
#define COLS (RES_X + 1)
#define PAGE_WIDTH 8
#define PAGES RES_Y / PAGE_WIDTH

uint8_t gBuffer[PAGES * COLS] = { 0 };

/**
 * @brief Transmit a byte to the OLED
 * 
 * @param data The byte to be transmit
 * @param mode Transmit mode
 * 
*/
void OLED_TransmitByte(uint8_t data, OLED_TransmitMode mode) {
	uint8_t send_buf[2] = { 0 };
	send_buf[0] = mode;
	send_buf[1] = data;
	HAL_I2C_Master_Transmit(&hi2c1, OLED_ADDRESS, send_buf, 2, 1);
}

/**
 * @brief Initialize the OLED screen, where V_{CC} generated by internal DC/DC circuit
 * 
*/
void OLED_Init() {
	// Set Display Off
	OLED_TransmitByte(0xAE, OLED_TRANSMIT_CTRL);

	// Set Display Clock Divide Ratio/Oscillator Frequency
	OLED_TransmitByte(0xD5, OLED_TRANSMIT_CTRL);
	OLED_TransmitByte(0x80, OLED_TRANSMIT_CTRL);

	// Set Multiplex Ratio
	OLED_TransmitByte(0xA8, OLED_TRANSMIT_CTRL);
	OLED_TransmitByte(0x3F, OLED_TRANSMIT_CTRL);

	// Set Display Offset
	OLED_TransmitByte(0xD3, OLED_TRANSMIT_CTRL);
	OLED_TransmitByte(0x00, OLED_TRANSMIT_CTRL);

	// Set Display Start Line
	OLED_TransmitByte(0x40, OLED_TRANSMIT_CTRL);

	// Set Charge Pump
	OLED_TransmitByte(0xad, OLED_TRANSMIT_CTRL);
	OLED_TransmitByte(0x8b, OLED_TRANSMIT_CTRL);

	// Set Segment Re-Map
	OLED_TransmitByte(0xA1, OLED_TRANSMIT_CTRL);

	// Set COM Output Scan Direction
	OLED_TransmitByte(0xC8, OLED_TRANSMIT_CTRL);

	// Set COM Pins Hardware Configuration
	OLED_TransmitByte(0xDA, OLED_TRANSMIT_CTRL);
	OLED_TransmitByte(0x12, OLED_TRANSMIT_CTRL);

	// Set Contrast Control 
	OLED_TransmitByte(0x81, OLED_TRANSMIT_CTRL);
	OLED_TransmitByte(0xff, OLED_TRANSMIT_CTRL);

	// Set Pre-Charge Period
	OLED_TransmitByte(0xD9, OLED_TRANSMIT_CTRL);
	OLED_TransmitByte(0x1f, OLED_TRANSMIT_CTRL);

	// Set VCOMH Deselect Level
	OLED_TransmitByte(0xdb, OLED_TRANSMIT_CTRL);
	OLED_TransmitByte(0x40, OLED_TRANSMIT_CTRL);

	// set VPP
	OLED_TransmitByte(0x33, OLED_TRANSMIT_CTRL);

	// Set Normal/Inverse Display
	OLED_TransmitByte(0xA6, OLED_TRANSMIT_CTRL);

	// Clear Screen
	OLED_ClearBuffer();
	OLED_Flush();

	// Set Display On
	OLED_TransmitByte(0xAF, OLED_TRANSMIT_CTRL);
}

/**
 * @brief De-initialize the OLED screen (need to be powered off)
 * 
*/
void OLED_Deinit() {
	// Set Display Off
	OLED_TransmitByte(0xAE, OLED_TRANSMIT_CTRL);

	// Set Charge Pump
	OLED_TransmitByte(0x8D, OLED_TRANSMIT_CTRL);
	OLED_TransmitByte(0x10, OLED_TRANSMIT_CTRL);
}

/**
 * @brief Let the OLED entering sleep mode
 * 
*/
void OLED_EnterSleep() {
	// Set Display Off
	OLED_TransmitByte(0xAE, OLED_TRANSMIT_CTRL);

	// Set Charge Pump
	OLED_TransmitByte(0xAD, OLED_TRANSMIT_CTRL);
	OLED_TransmitByte(0x8B, OLED_TRANSMIT_CTRL);
}

/**
 * @brief Let the OLED exiting sleep mode
 * 
*/
void OLED_ExitSleep() {
	// Set Charge Pump
	OLED_TransmitByte(0xAD, OLED_TRANSMIT_CTRL);
	OLED_TransmitByte(0x8A, OLED_TRANSMIT_CTRL);

	// Set Display On
	OLED_TransmitByte(0xAF, OLED_TRANSMIT_CTRL);
}


/**
 * @brief Set the filling mode of the display
 * 
 * @param mode filling mode
 * 
*/
void OLED_SetFillingMode(OLED_FillingMode mode) {
	switch (mode)
	{
	case OLED_FILLING_NORMAL:
		OLED_TransmitByte(0xA6, OLED_TRANSMIT_CTRL);
		break;
	case OLED_FILLING_REVERSED:
		OLED_TransmitByte(0xA7, OLED_TRANSMIT_CTRL);
		break;
	default:
		break;
	}
}

/**
 * @brief Set the orientation of the display
 * 
 * @param mode orientation mode
 * 
*/
void OLED_SetOrientation(OLED_OrientationMode mode) {
	switch (mode)
	{
	case OLED_ORIENTATION_NORMAL:
		OLED_TransmitByte(0xC8, OLED_TRANSMIT_CTRL);
		OLED_TransmitByte(0xA1, OLED_TRANSMIT_CTRL);
		break;
	case OLED_ORIENTATION_REVERSED:
		OLED_TransmitByte(0xC0, OLED_TRANSMIT_CTRL);
		OLED_TransmitByte(0xA0, OLED_TRANSMIT_CTRL);
		break;
	default:
		break;
	}
}

/**
 * @brief Flush the whole G-buffer to the OLED
 * 
*/
void OLED_Flush() {
	for (uint8_t page = 0; page < PAGES; page++) {
		// Set page
		OLED_TransmitByte(0xb0 + page, OLED_TRANSMIT_CTRL);
		// Set column
		OLED_TransmitByte(0x02, OLED_TRANSMIT_CTRL);
		OLED_TransmitByte(0x10, OLED_TRANSMIT_CTRL);
		// Set transmit
		gBuffer[page * COLS] = OLED_TRANSMIT_DATA;
		HAL_I2C_Master_Transmit(&hi2c1, OLED_ADDRESS, gBuffer + (page * COLS), COLS, 20);
	}
}

/**
 * @brief Clear the G-Buffer on the MCU
*/
void OLED_ClearBuffer() {
	memset(gBuffer, 0, sizeof(gBuffer));
}

/**
 * @brief Plot a point in the G-buffer
 * 
 * @param x X coordinate
 * @param y Y coordinate
 * @param mode plotting mode
 * 
*/
void OLED_Plot(uint8_t x, uint8_t y, OLED_PlottingMode mode) {
	if(x < 0 || x > RES_X || y < 0 || y > RES_Y) {
		return;
	}
	uint8_t col = x + 1;
	uint8_t page = y / PAGE_WIDTH;
	uint8_t row = y % PAGE_WIDTH;
	uint8_t colData = 1 << row;
	if (mode == OLED_PLOTTING_FILL) {
		gBuffer[page * COLS + col] |= colData;
	}
	else {
		gBuffer[page * COLS + col] &= ~colData;
	}
}

/**
 * @brief Plot an ASCII character in the G-buffer
 * @param x X coordinate [0, 127]
 * @param y Y coordinate [0, 63]
 * @param c the character to be plotted
 * @param font: font
 * @param foreground foreground mode
 * @param background background mode
 *
 * */
void OLED_PlotChar(uint8_t x, uint8_t y, char c, OLED_Font font, OLED_PlottingMode foreground, OLED_BackgroundMode background) {
	uint8_t x0 = x, y0 = y;
	uint8_t bitmapSize;
	if (font == 8)
		bitmapSize = 6;
	else
		bitmapSize = (font / 8 + ((font % 8) ? 1 : 0)) * (font / 2);
	uint8_t charIdx = c - ' ';
	for (uint8_t i = 0; i < bitmapSize; i++) {
		uint8_t temp;
		if (font == 8)
			temp = asc2_0806[charIdx][i]; // font 0806
		else if (font == 12)
			temp = asc2_1206[charIdx][i]; // font 1206
		else if (font == 16)
			temp = asc2_1608[charIdx][i]; // font 1608
		else if (font == 24)
			temp = asc2_2412[charIdx][i]; // font 2412
		else
			return;
		for (uint8_t m = 0; m < 8; m++) {
			if (temp & 0x01)
				OLED_Plot(x, y, foreground);
			else
				if (background == OLED_BACKGROUND_FILL)
					OLED_Plot(x, y, !foreground);

			temp >>= 1;
			y++;
		}
		x++;
		if ((font != 8) && ((x - x0) == font / 2)) {
			x = x0;
			y0 = y0 + 8;
		}
		y = y0;
	}
}

/**
 * @brief: Plot an ASCII string in the G-buffer
 * @param x X coordinate [0, 127]
 * @param y Y coordinate [0, 63]
 * @param s the string to be plotted
 * @param font: font
 * @param foreground foreground mode
 * @param background background mode
 *
 * */
void OLED_PlotString(uint8_t x, uint8_t y, char *s, OLED_Font font, OLED_PlottingMode foreground, OLED_BackgroundMode background) {
	while ((*s >= ' ') && (*s <= '~'))	// plot valid characters only
	{
		OLED_PlotChar(x, y, *s, font, foreground, background);
		if (font == 8)
			x += 6;
		else
			x += font / 2;
		s++;
	}
}
